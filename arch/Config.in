## arch/Config.in
```kconfig
choice
    prompt "Target Architecture"
    default BR2_ARCH_RPI3
    help
      Select the target architecture family to build for.

config BR2_ARCH_RPI3
    bool "Raspberry Pi 3 Model B"
    help
      The Raspberry Pi 3 is the third generation Raspberry Pi. 
      It replaced the Raspberry Pi 2 Model B in February 2016. 
      It has a 1.2GHz 64-bit quad-core ARMv8 CPU and 1GB RAM.

config BR2_ARCH_RPI2
    bool "Raspberry Pi 2 Model B"
    help
      The Raspberry Pi 2 Model B is the second generation Raspberry Pi. 
      It replaced the original Raspberry Pi 1 Model B+ in February 2015. 
      Is has a 900MHz quad-core ARM Cortex-A7 CPU and 1GB RAM.

config BR2_ARCH_RPI1
    bool "Raspberry Pi 1 Model B+"
    help
      The Model B+ is the final revision of the original Raspberry Pi.
      It replaced the Model B in July 2014 and was superseded by the 
      Raspberry Pi 2 Model B in February 2015.
      Is has a 700MHz ARM 11 CPU and 512MB RAM.

endchoice

config BR2_ARCH
    string
    default "rpi1" if BR2_ARCH_RPI1
    default "rpi2" if BR2_ARCH_RPI2
    default "rpi3" if BR2_ARCH_RPI3

choice
    prompt "Powerswitch Hardware"
    default BR2_ARCH_POWERSWITCH_REMOTEPI_2015

config BR2_ARCH_POWERSWITCH_REMOTEPI_2015
    bool "RemotePi Board for Pi3, Pi 2 and B+"
    help
        The RemotePi Board is an intelligent infrared remote controlled 
        power switch for the Raspberry Pi. 
        It is mainly intended to remote control and power off/on a media 
        center system (i.e LibreELEC, OpenELEC, OSMC, XBian, RasPlex, 
        Raspbian, Volumio, ...).
        http://www.msldigital.com/pages/support-for-remotepi-board-plus-2015

config BR2_ARCH_POWERSWITCH_REMOTEPI_2013
    bool "RemotePi Board 2013"
    help
        The RemotePi Board is an intelligent infrared remote controlled 
        power switch for the Raspberry Pi. 
        It is mainly intended to remote control and power off/on a media 
        center system (i.e LibreELEC, OpenELEC, OSMC, XBian, RasPlex, 
        Raspbian, Volumio, ...).
        http://www.msldigital.com/pages/support-for-remotepi-board-2013

config BR2_ARCH_POWERSWITCH_NONE
    bool "None"
    help
      Select this option if your powerswitch cannot be selected in the 
      list.

endchoice
```

## package/Config.in
```kconfig
source "package/noobs/Config.in"
source "package/rasplex/Config.in"
source "package/recalboxOS/Config.in"

config BR2_PACKAGE_RECALPLEX
    bool
    default BR2_PACKAGE_RASPLEX && BR2_PACKAGE_RASPLEX_SKIN_AEONNOX && \
            BR2_PACKAGE_RECALBOXOS
```

## package/noobs/Config.in
```kconfig
config BR2_PACKAGE_NOOBS
    bool "Noobs 2.1"
    default y
    help
      NOOBS is an easy operating system installer which contains Raspbian. 
      It also provides a selection of alternative operating systems which 
      are then downloaded from the internet and installed.

      https://www.raspberrypi.org/downloads/noobs/
```

## package/rasplex/Config.in
```kconfig
config BR2_PACKAGE_RASPLEX
    bool "Rasplex"
    default y
    help
      The Plex Home Theater port for the Raspberry Pi mini computer.
      Created from Plex Home Theater and OpenELEC Linux, with automatic 
      updates pushed out as they become available.

      http://www.rasplex.com

#####################################################################
#                       Version Selector
#####################################################################
choice
    prompt "Version"
    default BR2_PACKAGE_RASPLEX_STABLE
    depends on BR2_PACKAGE_RASPLEX

config BR2_PACKAGE_RASPLEX_STABLE
    bool "1.7.1 - Stable"
    help
      The last stable version from : 
      https://github.com/RasPlex/RasPlex/releases

config BR2_PACKAGE_RASPLEX_PRERELEASE
    bool "1.7.1 - Pre-release"
    help
      The last pre-release version from : 
      https://github.com/RasPlex/RasPlex/releases

endchoice

#####################################################################
#                       Skin Selector
#####################################################################
choice
    prompt "Custom Skin"
    default BR2_PACKAGE_RASPLEX_SKIN_PLEX_BLACK_EDITION
    depends on BR2_PACKAGE_RASPLEX

config BR2_PACKAGE_RASPLEX_SKIN_PLEX_BLACK_EDITION
    bool "Plex Black Edition Skin - Custom"
    help
      Skin customized with a Recalbox Section to automatically reboot to 
      Recalbox partiton.
      
      Plex Black Edition by DeadEyeFlint
      
      https://forums.plex.tv/discussion/129756/release-plex-black-edition

config BR2_PACKAGE_RASPLEX_SKIN_AEONNOX
    bool "Aeon Nox 5 - Custom"
    help
      Skin customized with a Recalbox Section to automatically reboot to 
      Recalbox partiton.
      
      Aeon Nox for Plex Home Theater by MagnumDoomguy
      
      Aeon Nox 5 for Plex has 28 different viewtypes, an intuitive and
      graceful GUI and lots of configuration options.
      Completely redesigned to create a modern look, while retaining 
      the classic Aeon feel.  Modified to run on Plex Home Theater.
      
      https://github.com/magnumdoomguy/skin.aeon.nox.5

config BR2_PACKAGE_RASPLEX_SKIN_OPENPHT
    bool "OpenPHT - Standard"
    help
      No change is made on the skin configuration.
     
      Default OpenPHT Skin
      http://www.rasplex.com/

endchoice
```

## package/recalbox/Config.in
```kconfig
config BR2_PACKAGE_RECALBOX
    bool "RecalboxOS - Latest"
    default y
    depends on BR2_PACKAGE_NOOBS
    help
      RecalboxOS is a light embedded system created to run on Raspberry Pi
      Raspberry Pi 2 and Raspberry PI 3.
      You can transform your rpi in an emulation platform, supporting up to
      32 systems !

      http://www.recalbox.com

#####################################################################
#                       Version Selector
#####################################################################
# choice
#     prompt "Version"
#     default BR2_PACKAGE_RECALBOX_STABLE
#     depends on BR2_PACKAGE_RECALBOX

# config BR2_PACKAGE_RECALBOX_STABLE
#     bool "6.1.1-Dragonblaze"
#     help
#       The last stable version from : 
#       https://archive.recalbox.com/

# config BR2_PACKAGE_RECALBOX_STABLE
#     bool "4.0.1 - Stable"
#     help
#       The last stable version from : 
#       https://github.com/recalbox/recalbox-os/releases

# config BR2_PACKAGE_RECALBOX_UNSTABLE
#     bool "4.0.x - Unstable"
#     help
#       The last stable version from : 
#       https://github.com/recalbox/recalbox-os/releases 
#       patched with boot.tar.xz and root.tar.xz from :
#       http://archive.recalbox.com/4/rpi?/unstable/last
      
#       Try it at your own risks !!!

# config BR2_PACKAGE_RECALBOX_NEXT
#     bool "4.1.x - Unstable"
#     help
#       The last stable version from : 
#       https://github.com/recalbox/recalbox-os/releases 
#       patched with boot.tar.xz and root.tar.xz from :
#       http://archive.recalbox.com/4.1/rpi?/unstable/last
      
#       Try it at your own risks !!!


# endchoice
```

## package/recalboxOS/Config.in
```kconfig
config BR2_PACKAGE_RECALBOXOS
    bool "RecalboxOS"
    default y
    help
      RecalboxOS is a light embedded system created to run on Raspberry Pi
      Raspberry Pi 2 and Raspberry PI 3.
      You can transform your rpi in an emulation platform, supporting up to
      32 systems !

      http://www.recalbox.com

#####################################################################
#                       Version Selector
#####################################################################
choice
    prompt "Version"
    default BR2_PACKAGE_RECALBOXOS_STABLE
    depends on BR2_PACKAGE_RECALBOXOS

config BR2_PACKAGE_RECALBOXOS_STABLE
    bool "4.0.1 - Stable"
    help
      The last stable version from : 
      https://github.com/recalbox/recalbox-os/releases

config BR2_PACKAGE_RECALBOXOS_UNSTABLE
    bool "4.0.x - Unstable"
    help
      The last stable version from : 
      https://github.com/recalbox/recalbox-os/releases 
      patched with boot.tar.xz and root.tar.xz from :
      http://archive.recalbox.com/4/rpi?/unstable/last
      
      Try it at your own risks !!!

config BR2_PACKAGE_RECALBOXOS_NEXT
    bool "4.1.x - Unstable"
    help
      The last stable version from : 
      https://github.com/recalbox/recalbox-os/releases 
      patched with boot.tar.xz and root.tar.xz from :
      http://archive.recalbox.com/4.1/rpi?/unstable/last
      
      Try it at your own risks !!!

endchoice
```
